/********************************** (C) COPYRIGHT *******************************
* File Name          : main.c
* Author             : WCH
* Version            : V1.0.0
* Date               : 2021/08/08
* Description        : Main program body.
* Copyright (c) 2021 Nanjing Qinheng Microelectronics Co., Ltd.
* SPDX-License-Identifier: Apache-2.0
*******************************************************************************/

/*
 *@Note
 ETH及内部10BASE-T物理层演示例程：
 以太网打印出接收到的帧的前22个字节，并发送固定的帧到对端。
 注意：本例程在主频为120MHz下演示。
*/

#include "debug.h"
#include "main.h"
#include "ETH.h"

/* Global Variable */

uint8_t user_buff[1500];
extern RXBUFST RxCtrl;   //接收管理参数

/* Transport sample */
uint8_t ARP_package[] =
{
    0xff, 0xff, 0xff, 0xff, 0xff, 0xff,/* 目标MAC */
    0x84, 0xc2, 0xe4, 0x01, 0x02, 0x03,/* 源MAC */
    0x08, 0x06, /* ARP包 */
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    0xc0, 0xa8, 0x01, 0x65, /* 源协议地址 */
#if 0/*padding 16bytes*行数   */
    0x55, 0x55, 0x55, 0x55, 0x55, 0x55, 0x55, 0x55, 0xaa, 0xaa, 0xaa, 0xaa, 0xaa, 0xaa, 0xaa, 0xaa,
    0x55, 0x55, 0x55, 0x55, 0x55, 0x55, 0x55, 0x55, 0x55, 0x55, 0x55, 0x55, 0x55, 0x55, 0x55, 0x55,
    0x55, 0x55, 0x55, 0x55, 0x55, 0x55, 0x55, 0x55, 0x55, 0x55, 0x55, 0x55, 0x55, 0x55, 0x55, 0x55,
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    0x55, 0x55, 0x55, 0x55, 0x55, 0x55, 0x55, 0x55, 0x66, 0x55, 0x55, 0xee, 0x96, 0x85, 0x25, 0xaa
#endif
};

/*********************************************************************
 * @fn      SET_MCO
 *
 * @brief   Set MCO wave output.
 *
 * @return  none
 */
void SET_MCO( void )
{
    GPIO_InitTypeDef GPIO = {0};

    RCC_APB2PeriphClockCmd( RCC_APB2Periph_GPIOA, ENABLE );

    GPIO.GPIO_Pin = GPIO_Pin_8;
    GPIO.GPIO_Mode = GPIO_Mode_AF_PP;
    GPIO.GPIO_Speed = GPIO_Speed_50MHz;
    GPIO_Init( GPIOA, &GPIO );
    RCC_MCOConfig( RCC_MCO_SYSCLK );
    Delay_Ms( 100 );
    RCC_APB2PeriphClockCmd( RCC_APB2Periph_AFIO, ENABLE );
}

/*********************************************************************
 * @fn      TIM1_Init
 *
 * @brief   Initializes the TIM1 configuration.
 *
 * @return  none
 */
void TIM1_Init( void )
{
    TIM_TimeBaseInitTypeDef  TIM_TimeBaseStructure = {0};

    RCC_APB2PeriphClockCmd( RCC_APB2Periph_TIM1, ENABLE );

    TIM_TimeBaseStructure.TIM_Period = 1000;
    TIM_TimeBaseStructure.TIM_Prescaler = 60000;
    TIM_TimeBaseStructure.TIM_ClockDivision = 0;
    TIM_TimeBaseStructure.TIM_CounterMode = TIM_CounterMode_Up;
    TIM_TimeBaseInit( TIM1, &TIM_TimeBaseStructure );

    TIM_ITConfig( TIM1, TIM_IT_Update, ENABLE );

    TIM_Cmd( TIM1, ENABLE );
}

/*********************************************************************
 * @fn      TIM3_Init
 *
 * @brief   Initializes the TIM3 configuration.
 *
 * @return  none
 */
void TIM3_Init( void )
{
    TIM_TimeBaseInitTypeDef  TIM_TimeBaseStructure = {0};

    RCC_APB1PeriphClockCmd( RCC_APB1Periph_TIM3, ENABLE );

    TIM_TimeBaseStructure.TIM_Period = 60000;
    TIM_TimeBaseStructure.TIM_Prescaler = 60000;
    TIM_TimeBaseStructure.TIM_ClockDivision = 0;
    TIM_TimeBaseStructure.TIM_CounterMode = TIM_CounterMode_Up;
    TIM_TimeBaseInit( TIM3, &TIM_TimeBaseStructure );
}

/*********************************************************************
 * @fn      event_int
 *
 * @brief   Init event
 *
 * @return  none
 */
void event_int( void )
{
    GPIO_InitTypeDef GPIO_InitStructure;

    RCC_APB2PeriphClockCmd( RCC_APB2Periph_GPIOA, ENABLE );

    GPIO_InitStructure.GPIO_Pin = GPIO_Pin_0;
    GPIO_InitStructure.GPIO_Mode = GPIO_Mode_Out_PP;
    GPIO_InitStructure.GPIO_Speed = GPIO_Speed_50MHz;
    GPIO_Init( GPIOA, &GPIO_InitStructure );

    GPIOA->BCR = GPIO_Pin_0;
}

/*********************************************************************
 * @fn      main
 *
 * @brief   Main program.
 *
 * @return  none
 */
int main( void )
{
    RCC_ClocksTypeDef RCC_ClocksStatus;
    uint16_t reg_value;

    Delay_Init();
    USART_Printf_Init( 115200 );
    RCC_GetClocksFreq( &RCC_ClocksStatus );
    printf( "WCH Ethernet internal 10BASE-T PHY demo program.Complair @ %s,%s.\n", __DATE__, __TIME__ );
    printf( "SystemClk:%d Hz.\n", RCC_ClocksStatus.SYSCLK_Frequency );
    printf( "PCK1_Clk:%d Hz.\n", RCC_ClocksStatus.PCLK1_Frequency );
    printf( "PCK2_Clk:%d Hz.\n", RCC_ClocksStatus.PCLK2_Frequency );
    event_int();
    /* Set 主频输出  */
    SET_MCO();
    /* TIM1 initialization */
    TIM1_Init();

    /* ETH initialization */
    RCC_ETHDIVConfig( RCC_ETHCLK_Div2 );
    RCC_AHBPeriphClockCmd( RCC_AHBPeriph_ETH_MAC | RCC_AHBPeriph_ETH_MAC_Tx | RCC_AHBPeriph_ETH_MAC_Rx, ENABLE ); /* 开启以太网时钟 */
    EXTEN->EXTEN_CTR |= EXTEN_ETH_10M_EN;

    TIM3_Init();
    ETHInit( 1516 );

    printf( "bmcr:0x%04x.\n", ReadPHYReg( 0 ) );

    reg_value = ReadPHYReg( 0 );
    WritePHYReg( 0, 0x8000 & reg_value );
    while( ReadPHYReg( 0 ) & 0x8000 );
    GPIOA->OUTDR |= ( 1 << 0 );
    TIM_Cmd( TIM3, ENABLE );
    NVIC_EnableIRQ( ETH_IRQn );

    ETH10->EIE = 0XFF;
    ETH10->ECON2 = 0x06;

    printf( "Enter main loop.\n" );

    while( 1 )
    {
        Delay_Ms( 10 );

        if( RxCtrl.RemainCount )
        {
            ETHRec( user_buff );
        }
        if( ( TIM1->INTFR ) & 1 )
        {
            ETHSend( ARP_package, sizeof( ARP_package ) );
            printf( "Warning:Send failed.\n" );
            TIM_ClearFlag( TIM1, TIM_IT_Update ); /* 使能更新中断 */
        }
    }
}

/*********************************************************************
 * @fn      ETH_IRQHandler
 *
 * @brief   This function handles ETH exception.
 *
 * @return  none
 */
void ETH_IRQHandler( void )
{
    ETH_IRQ_Deal();
}



